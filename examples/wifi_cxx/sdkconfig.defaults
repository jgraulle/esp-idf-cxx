## examples/wifi_cxx/sdkconfig.defaults
```kconfig
# Enable C++ exceptions and set emergency pool size for exception objects
CONFIG_COMPILER_CXX_EXCEPTIONS=y
CONFIG_COMPILER_CXX_EXCEPTIONS_EMG_POOL_SIZE=1024

# Serial flasher config
CONFIG_ESPTOOLPY_FLASHSIZE_4MB=y

# Partition Table set to large
CONFIG_PARTITION_TABLE_SINGLE_APP_LARGE=y
```
